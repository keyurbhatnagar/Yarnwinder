/*     Simple Stepper Motor Control Exaple Code
 *      
 *  by Dejan Nedelkovski, www.HowToMechatronics.com
 *  
 */


#include <SPI.h>
#include <Wire.h>
#include <Adafruit_GFX.h>
#include <Adafruit_SSD1306.h>

#define OLED_RESET 4
Adafruit_SSD1306 display(OLED_RESET);

#define NUMFLAKES 10
#define XPOS 0
#define YPOS 1
#define DELTAY 2


#define LOGO16_GLCD_HEIGHT 16 
#define LOGO16_GLCD_WIDTH  16 

const unsigned char PROGMEM logoname [] = {
0x00, 0x00, 0x00, 0x00, 0x00, 0x00, 0x00, 0x00, 0x00, 0x00, 0x00, 0x00, 0x00, 0x00, 0x00, 0x00,
0x00, 0x00, 0x00, 0x02, 0x00, 0x00, 0x00, 0x00, 0x00, 0x00, 0x00, 0x00, 0x00, 0x00, 0x03, 0xE0,
0x00, 0x01, 0x00, 0x00, 0x00, 0x00, 0x00, 0x07, 0x80, 0x03, 0xF0, 0x00, 0x3D, 0x80, 0x00, 0x00,
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0x00, 0x00, 0x00, 0x00, 0x00, 0x00, 0x00, 0x00, 0x00, 0x00, 0x00, 0x00, 0x00, 0x00, 
};

const unsigned char PROGMEM logo [] = {
0x00, 0x00, 0x00, 0x00, 0x00, 0x00, 0x00, 0x00, 0x00, 0x00, 0x00, 0x00, 0x00, 0x00, 0x00, 0x00,
0x00, 0x00, 0x00, 0x00, 0x00, 0x00, 0x00, 0x00, 0x00, 0x00, 0x00, 0x00, 0x00, 0x00, 0x00, 0x00,
0x00, 0x00, 0x00, 0x00, 0x00, 0x00, 0x00, 0x00, 0x00, 0x00, 0x00, 0x00, 0x00, 0x00, 0x00, 0x00,
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0x00, 0x00, 0x00, 0x00, 0x00, 0x00, 0x00, 0x00, 0x00, 0x00, 0x00, 0x00, 0x00, 0x00, 0x00, 0x00
};


#if (SSD1306_LCDHEIGHT != 64)
#error("Height incorrect, please fix Adafruit_SSD1306.h!");
#endif

#define encoder0PinA  2
#define encoder0PinB  3
#define buzzerPin 5
int sensorPin = 0;
char number[4];
static int pinA = 2; // Our first hardware interrupt pin is digital pin 2
static int pinB = 3; // Our second hardware interrupt pin is digital pin 3
static int pinSwitch = 12;
volatile byte aFlag = 0; // let's us know when we're expecting a rising edge on pinA to signal that the encoder has arrived at a detent
volatile byte bFlag = 0; // let's us know when we're expecting a rising edge on pinB to signal that the encoder has arrived at a detent (opposite direction to when aFlag is set)
volatile byte encoder0Pos = 1, lastPosition = 1; //this variable stores our current value of encoder position. Change to int or uin16_t instead of byte if you want to record a larger range than 0-255
volatile byte oldEncPos = 0; //stores the last encoder position value so we can compare to the current reading and see if it has changed (so we know when to print to the serial monitor)
volatile byte reading = 0; //somewhere to store the direct values we read from our interrupt pins before checking to see if we have moved a whole detent
bool bEnable = false;
int lastPinSwitchState = LOW;

int PUL=7; //define Pulse pin
int DIR=6; //define Direction pin
int ENA=5; //define Enable Pin

// Defines pins numbers
const int stepPin = 4;
const int dirPin = 5; 

int customDelay,customDelayMapped; // Defines variables
 
void setup() {
  // Sets the two pins as Outputs
  //pinMode(stepPin,OUTPUT);
  //pinMode(dirPin,OUTPUT);
  //digitalWrite(dirPin,HIGH); //Enables the motor to move in a particular direction

  //Motor Controller
  pinMode (PUL, OUTPUT);
  pinMode (DIR, OUTPUT);
  pinMode (ENA, OUTPUT);
  
  digitalWrite(DIR,LOW);
  //digitalWrite(ENA,HIGH);

  pinMode(pinA, INPUT_PULLUP); // set pinA as an input, pulled HIGH to the logic voltage (5V or 3.3V for most cases)
  pinMode(pinB, INPUT_PULLUP); // set pinB as an input, pulled HIGH to the logic voltage (5V or 3.3V for most cases)
  attachInterrupt(0,PinA,RISING); // set an interrupt on PinA, looking for a rising edge signal and executing the "PinA" Interrupt Service Routine (below)
  attachInterrupt(1,PinB,RISING); // set an interrupt on PinB, looking for a rising edge signal and executing the "PinB" Interrupt Service Routine (below)
  pinMode(pinSwitch, INPUT);
  digitalWrite(pinSwitch, HIGH);
  
  Serial.begin (9600);
  Serial.println("start");                // a personal quirk

  // by default, we'll generate the high voltage from the 3.3v line internally! (neat!)
  display.begin(SSD1306_SWITCHCAPVCC, 0x3C);  // initialize with the I2C addr 0x3D (for the 128x64)
  // init done
  
  
  display.clearDisplay();

  for(int i=45; i>=-16; i-- )
  {
    display.clearDisplay();
  // miniature bitmap display
    display.drawBitmap(0, i,  logo, 128, 55, 1);
    display.display();
    delay(1);
  }

  delay(500);
  Serial.println("logo done");                // a personal quirk

  display.clearDisplay();
  
  display.drawBitmap(0, -16,  logo, 128, 55, 1);
  display.display();
  display.setTextSize(2);
  display.setTextColor(WHITE);
  display.setCursor(12,40);
  display.println("Motor OFF");
  display.setTextSize(1);
  display.println(" Press knob to start.");
  display.display();
  
}

void PinA(){
  Serial.println("PinA");
  cli(); //stop interrupts happening before we read pin values
  reading = PIND & 0xC; // read all eight pin values then strip away all but pinA and pinB's values
  if(reading == B00001100 && aFlag) { //check that we have both pins at detent (HIGH) and that we are expecting detent on this pin's rising edge
    incrementPos(); //decrement the encoder's position count
    bFlag = 0; //reset flags for the next turn
    aFlag = 0; //reset flags for the next turn
  }
  else if (reading == B00000100) bFlag = 1; //signal that we're expecting pinB to signal the transition to detent from free rotation
  sei(); //restart interrupts
}

void PinB(){
  Serial.println("PinB");
  cli(); //stop interrupts happening before we read pin values
  reading = PIND & 0xC; //read all eight pin values then strip away all but pinA and pinB's values
  if (reading == B00001100 && bFlag) { //check that we have both pins at detent (HIGH) and that we are expecting detent on this pin's rising edge
    decrementPos(); //increment the encoder's position count
    bFlag = 0; //reset flags for the next turn
    aFlag = 0; //reset flags for the next turn
  }
  else if (reading == B00001000) aFlag = 1; //signal that we're expecting pinA to signal the transition to detent from free rotation
  sei(); //restart interrupts
}

void testdrawchar(int count) {
  memset(number, 0, sizeof(number));
  sprintf(number,"%d", count);
  display.setTextSize(1);
  display.setCursor(1,40);
  display.println("Speed");
  display.setTextSize(2);
  display.setTextColor(WHITE);
  if( strlen(number) == 1 )
  {
    display.setCursor(11,50);
  }
//  else if( strlen(number) == 2 )
//  {
//    display.setCursor(98,55);
//  }
//  else
//  {
//    display.setCursor(96,42);
//  }
  for(int i = 0;i<4;i++)
  {
    if( number[i] != 0 )
    {
      display.write(number[i]);
    }
  }
  display.display();
}

void testdrawrect(int i) {
  display.clearDisplay();
  display.drawBitmap(0, -16,  logo, 128, 55, 1);
  for(int n = 0; n < 5; n++)
  {
    display.drawRect(34+n*18, 51 - n*5, 16, 13 + n*5, WHITE);
  }

  for(int k = 0; k < i; k++)
  {
    display.fillRect(36+k*18, 53 - k*5, 12, 9 + k*5, WHITE);
  }
  
  display.display();

  testdrawchar(i);
  
  delay(1);
}

void loop() {

  int currentPinState = digitalRead(pinSwitch);
  if(currentPinState == LOW && currentPinState != lastPinSwitchState )//if button pull down
  {
    bEnable = !bEnable;
    if( !bEnable )
    {
      encoder0Pos = 1;    
      display.clearDisplay(); 
      display.drawBitmap(0, -16,  logo, 128, 55, 1);
      display.display();
      display.setTextSize(2);
      display.setTextColor(WHITE);
      display.setCursor(12,40);
      display.println("Motor OFF");
      display.setTextSize(1);
      display.println(" Press knob to start.");
      display.display();
      digitalWrite(ENA,LOW);
    }
    else
    {
      testdrawrect(encoder0Pos);
      digitalWrite(ENA,HIGH);
    }
    Serial.print("Motor Enabled : ");
    Serial.println(bEnable);
    lastPinSwitchState = currentPinState;
  }
  else if( currentPinState == HIGH )
  {
    lastPinSwitchState = currentPinState;
  }

  if( bEnable )
  {
    if( lastPosition != encoder0Pos  )
    {
      Serial.println(encoder0Pos);
      testdrawrect(encoder0Pos);
      lastPosition = encoder0Pos;
    }
    
    customDelayMapped = speedUp(); // Gets custom delay values from the custom speedUp function
    // Makes pules with custom delay, depending on the Potentiometer, from which the speed of the motor depends
    digitalWrite(PUL, HIGH);
    delayMicroseconds(customDelayMapped);
    digitalWrite(PUL, LOW);
    delayMicroseconds(customDelayMapped);
  }
}

void decrementPos()
{
  if( encoder0Pos > 1 )
  {
    encoder0Pos = encoder0Pos - 1;
  }
}

void incrementPos()
{
  if( encoder0Pos < 5 )
  {
    encoder0Pos = encoder0Pos + 1;
  }
}

// Function for reading the Potentiometer
int speedUp() {
  int newCustom = map(encoder0Pos, 1, 5, 100,13); // Convrests the read values of the potentiometer from 0 to 1023 into desireded delay values (300 to 4000)
  return newCustom;  
}
